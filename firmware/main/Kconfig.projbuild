## firmware/main/Kconfig.projbuild
```kconfig
menu "App configuration"

menu "I2C (LCD)"
config APP_I2C_SDA
    int "I2C SDA"
    range 0 48
    default 10     # ESP32-C6: zalecane GPIO10

config APP_I2C_SCL
    int "I2C SCL"
    range 0 48
    default 11     # ESP32-C6: zalecane GPIO11

config APP_I2C_HZ
    int "I2C Hz"
    default 100000 # zacznij od 100kHz (bezpiecznie dla LCD V2.0)
endmenu

menu "LCD"
config APP_LCD_ADDR
    hex "LCD 7-bit address"
    default 0x3E   # AIP31068/ST7032
endmenu

menu "1-Wire / DS18B20"
config APP_OW_GPIO
    int "1-Wire GPIO"
    range 0 48
    default 18
config APP_DS_RES
    int "DS18B20 resolution (9..12)"
    range 9 12
    default 12
endmenu

menu "UART (console/logger)"
config APP_UART_NUM
    int "UART num"
    range 0 2
    default 0
config APP_UART_TX
    int "UART TX gpio"
    range 0 48
    default 16     # U0TXD
config APP_UART_RX
    int "UART RX gpio"
    range 0 48
    default 17     # U0RXD
config APP_UART_BAUD
    int "UART baud"
    default 115200
endmenu

endmenu
```

## firmware/sdkconfig.defaults
```kconfig
# firmware/sdkconfig.defaults
CONFIG_IDF_TARGET="esp32c6"
CONFIG_IDF_TARGET_ESP32C6=y

# Konsola po UART0
CONFIG_ESP_CONSOLE_UART_DEFAULT=y
CONFIG_ESP_CONSOLE_UART=y
CONFIG_ESP_CONSOLE_UART_NUM=0
CONFIG_ESP_CONSOLE_UART_BAUDRATE=115200
# CONFIG_ESP_CONSOLE_UART_NONE is not set

# Flash 8 MB (nagłówek obrazu)
CONFIG_ESPTOOLPY_FLASHSIZE_8MB=y
CONFIG_ESPTOOLPY_FLASHSIZE="8MB"
```
